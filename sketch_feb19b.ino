#include <LiquidCrystalRus.h>

#define BUTTON 2
#define BUZZER 3

void buttonControl();

int dinoLine = 1;                           // номер строки, в которой стоит динозаврик
int level = 1;                              // переменная для хранения текущего уровня игры
int pause = 400;                            // переменная для хранения времени между перемещениями препятствия
unsigned long int timer;                    // таймер для расчета времени прыжка
volatile boolean jump = false;              // состояние прыжка
LiquidCrystalRus lcd(13, 12, 11, 10, 9, 8); // присваиваем имя lcd для дисплея

byte dino[8] = {0b11111, 0b10111, 0b11111, 0b11100, 0b11110, 0b11100, 0b10010, 0b11011};  // массив для дракончика
byte tree[8] = {0b00000, 0b01110, 0b11111, 0b11111, 0b01110, 0b00100, 0b00100, 0b00100};  // массив для дерева
byte stone[8] = {0b00000, 0b00000, 0b00000, 0b00000, 0b00000, 0b00000, 0b01110, 0b11111}; // массив для камня
byte bird[8] = {0b00000, 0b00010, 0b00011, 0b01011, 0b11111, 0b00000, 0b00000, 0b00000};  // массив для птицы

void setup()
{
  randomSeed(analogRead(A0));                    // функция для генерации более случайных чисел, используя помехи из аналогового пина
  pinMode(BUZZER, OUTPUT);                       // подключаем пьезодинамик
  pinMode(BUTTON, INPUT_PULLUP);                 // подключаем кнопку
  lcd.begin(16, 2);                              // запуск lcd дисплея
  lcd.createChar(0, dino);                       // создаем символ динозаврика, под номером 0
  lcd.createChar(1, tree);                       // создаем символ дерева, под номером 1
  lcd.createChar(2, stone);                      // создаем символ камня, под номером 2
  lcd.createChar(3, bird);                       // создаем символ птицы, под номером 3
  lcd.setCursor(5, 0);                           // выставляем курсор, чтобы надпись была по цетру строки
  lcd.print("СТАРТ!");                           // выводим слово СТАРТ
  tone(BUZZER, 600);                             // звуковой сигнал начала
  delay(600);                                    // дадим время подготовиться перед началом
  noTone(BUZZER);                                // выключаем сигнал
  attachInterrupt(INT0, buttonControl, FALLING); // запускаем прерывания по нажатию кнопки
}

void buttonControl() // функция, вызываемая при прерывании
{
  delay(10);                         // боремся с дребезгом кнопки
  if (!digitalRead(BUTTON) && !jump) // если кнопка нажата сейчас, и сейчас нет прыжка, то
  {
    jump = true; // прыгаем
  }
}

void loop()
{
  int barrierColumn = 15;          // задаем начальные координаты для препятствия - самый правый столбец
  int barrierLine;                 // в этой переменной будет храниться номер строки для препятствия
  int barrierStyle = random(1, 4); // выбираем случайное препятствие, от 1 до 3
  if (barrierStyle == 3)           // если выпало препятствие №3, птица, то
    barrierLine = 0;               // выбираем верхнюю строчку
  else                             // во всех остальных случаях
    barrierLine = 1;               // препятствие будет на нижней строке

  while (barrierColumn > 0) // до тех пор, пока препятствие не добралось до левого края экрана
  {
    lcd.clear();          // очищаем экран
    lcd.print(level);     // в углу пишем номер уровня
    if (jump && dinoLine) // если кнопка была нажата (прыжок есть) и динозаврик стоит в нижней строке
    {
      dinoLine = 0;           // переставляем динозавра наверх
      tone(BUZZER, 200, 100); // подаем звуковой сигнал
      timer = millis();       // запоминаем время
    }
    if (!dinoLine && ((millis() - timer) >= (pause * 2))) // если динозавр в верхней строчке, и прошло нужное количество времени, то
    {
      dinoLine = 1; // возвращаем динозаврика на землю
      jump = false; // заканчиваем прыжок
    }
    lcd.setCursor(4, dinoLine);                // ставим курсор на координаты динозаврика - всегда 4 столбец, а строка зависит от кнопки
    lcd.print(char(0));                        // рисуем символ №0, то есть динозаврика
    lcd.setCursor(barrierColumn, barrierLine); // выставляем курсор по координатам для препятствия
    lcd.print(char(barrierStyle));             // рисуем то препятствие, которое выбрали в начале

    if (barrierColumn == 4 && dinoLine == barrierLine) // если координаты препятствия и динозаврика совпали, значит, они столкнулись
    {
      delay(400); // звуковой сигнал поражения
      tone(BUZZER, 50);
      delay(100);
      noTone(BUZZER);
      delay(100);
      tone(BUZZER, 20);
      delay(300);
      noTone(BUZZER);
      lcd.clear();
      delay(200);
      lcd.setCursor(3, 0); // выводим сообщение GAME OVER и уровень, на котором остановились
      lcd.print("GAME OVER!");
      delay(600);
      lcd.clear();
      delay(400);
      lcd.setCursor(3, 0);
      lcd.print("GAME OVER!");
      delay(600);
      lcd.clear();
      lcd.setCursor(3, 1);
      lcd.print("Уровень: ");
      lcd.print(level);
      delay(400);
      lcd.setCursor(3, 0);
      lcd.print("GAME OVER!");
      while (digitalRead(BUTTON)) // завешиваем плату в пустом цикле до тех пор, пока не нажмем на кнопку
      {
      }
      lcd.clear();         // очищаем экран
      lcd.setCursor(5, 0); // начинаем игру заново
      lcd.print("СТАРТ!");
      delay(600);
      tone(BUZZER, 600, 100);
      level = 0;   // сбрасываем уровень
      pause = 400; // возвращаем начальное значение паузы
      break;       // выходим из цикла while
    }
    else // если столкновения не было, то
    {
      delay(pause);    // ждем нужное время
      --barrierColumn; // и переставляем препятствие левее
    }
  }
  tone(BUZZER, 800, 20); // когда препятствие благополучно достигло левого края, подаем звуковой сигнал
  ++level;               // увеличиваем уровень
  if (pause > 120)       // если размер паузы больше 120, то
    pause -= 20;         // уменьшаем ее на 20 мс
  else if (pause <= 120) // если же пауза уже дошла до 120, то
    pause = 120;         // фиксируем на этом значении
}
